// SPDX-License-Identifier: (GPL-2.0 OR MIT)
/*
 * Copyright 2025 Logic PD, Inc. DBA BeaconEmbeddedWorks
 */

/dts-v1/;

#include "imx8mn.dtsi"
#include "imx8mn-beacon-som-12.dtsi"
#include "imx8mn-beacon-baseboard.dtsi"
#include "imx8mn-beacon-lvds.dtsi"

/ {
	model = "Beacon EmbeddedWorks i.MX8M Nano Development Kit (LVDS)";
	compatible = "beacon,imx8mn-beacon-kit", "fsl,imx8mn";

	chosen {
		stdout-path = &uart2;
	};
};
