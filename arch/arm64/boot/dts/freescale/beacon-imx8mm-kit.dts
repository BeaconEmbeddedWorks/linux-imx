// SPDX-License-Identifier: (GPL-2.0 OR MIT)
/*
 * Copyright 2020 Beacon EmbeddedWorks
 */

/dts-v1/;

#include "fsl-imx8mm.dtsi"
#include "beacon-imx8mm-som.dtsi"
#include "beacon-imx8mm-baseboard.dtsi"
#include "beacon-imx8mm-lvds.dtsi"

/ {
	model = "beacon EmbeddedWorks i.MX8M mini Developent Kit";
	compatible = "fsl,imx8mm";

	chosen {
		stdout-path = &uart2;
	};
};
