// SPDX-License-Identifier: (GPL-2.0 OR MIT)
/*
 * Copyright 2021 Logic PD, Inc. DBA BeaconEmbeddedWorks
 */

/dts-v1/;

#include "imx8mn-beacon-12.dts"
#include "imx8mn-beacon-spidev.dtsi"

/ {
	model = "Beacon EmbeddedWorks i.MX8M Nano Development Kit (SPIDEV)";
};
